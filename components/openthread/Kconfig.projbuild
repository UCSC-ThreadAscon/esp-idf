## components/openthread/Kconfig.projbuild
```kconfig
#
# I use the following resource to learn how to create KConfig
# configurations:
# https://medium.com/@bhautik.markeye/esp-idf-configuration-how-to-add-custom-configuration-in-project-config-728f81b8d0d8.
#

menu "Ascon-OpenThread Encryption"

  config THREAD_ASCON_CIPHER_SUITE
    int "Determines which cipher suite OpenThread should use."
    default 0
    range 0 7
    help
      Option "0" enables AES encryption (default).
      Option "1" disables all encryption.
      Option "2" enables the ESP32 optimized version of ASCON-128a.
      Option "3" enables the reference implementation of ASCON-128a.
      Option "4" enables the ASCON-128a implemenation from LibAscon, which uses variable tag length.
      Option "5" enables the ASCON-128 implementation of LibAscon, which uses variable tag length.
      Option "7" MbedTTS CHACHAPOLY implementation.

  config THREAD_ASCON_HEX_DUMP
    int "Determine whether or not to enable hex dump printing."
    default 0
    range 0 4
    help
      Toggles hex dump printing of the key, nonce, associated data, 
      ciphertext/plaintext (depending on which option is set), and tag
      to verify that the LibAscon implemenentations of ASCON-128a and ASCON-128
      are successfully working.

      Note that this option does NOTHING when AES is used.

      Option "0" disables ASCON hex dump.
      Option "1" enables hex dump for MAC Layer ENCRYPTION for both LibAscon-128a and LibAscon-128.
      Option "2" enables hex dump for MLE ENCRYPTION for both LibAscon-128a and LibAscon-128.
      Option "3" enables hex dump for MAC layer DECRYPTION for both LibAscon-128a and LibAscon-128.
      Option "4" enables hex dump for MLE DECRYPTION for both LibAscon-128a and LibAscon-128.
  endmenu
```
